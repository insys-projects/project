## board/Config.in
```kconfig
source "$BR2_EXTERNAL_INSYS_DM8168_PATH/package/gipcy/Config.in"
source "$BR2_EXTERNAL_INSYS_DM8168_PATH/package/bardy/Config.in"
```

## board/configs/fm403c_defconfig
```kconfig
BR2_arm=y
BR2_cortex_a8=y
BR2_ARM_EABI=y
BR2_ARM_SOFT_FLOAT=y
BR2_DL_DIR="$(HOME)/project/downloads"
BR2_JLEVEL=4
BR2_TOOLCHAIN_EXTERNAL=y
BR2_TOOLCHAIN_EXTERNAL_CUSTOM=y
BR2_TOOLCHAIN_EXTERNAL_DOWNLOAD=y
BR2_TOOLCHAIN_EXTERNAL_URL="http://software-dl.ti.com/sdoemb/sdoemb_public_sw/arago_toolchain/2011_09/exports/arago-2011.09-armv7a-linux-gnueabi-sdk.tar.bz2"
BR2_TOOLCHAIN_EXTERNAL_CUSTOM_PREFIX="$(ARCH)-arago-linux-gnueabi"
BR2_TOOLCHAIN_EXTERNAL_GCC_4_5=y
BR2_TOOLCHAIN_EXTERNAL_CUSTOM_GLIBC=y
BR2_TOOLCHAIN_EXTERNAL_CXX=y
BR2_PACKAGE_HOST_GDB=y
BR2_PACKAGE_HOST_GDB_TUI=y
BR2_PACKAGE_HOST_GDB_PYTHON=y
BR2_ECLIPSE_REGISTER=y
BR2_TARGET_GENERIC_HOSTNAME="fm403c"
BR2_TARGET_GENERIC_ISSUE="Welcome to FM403C"
BR2_TARGET_GENERIC_ROOT_PASSWD="qwe123"
BR2_ROOTFS_OVERLAY="$(BR2_EXTERNAL)/insys/common/rootfs_overlay"
BR2_ROOTFS_POST_BUILD_SCRIPT="$(BR2_EXTERNAL)/insys/common/build-bardy.sh $(BR2_EXTERNAL)/insys/common/post_build.sh"
BR2_ROOTFS_POST_SCRIPT_ARGS="fm403c"
BR2_LINUX_KERNEL=y
BR2_LINUX_KERNEL_CUSTOM_GIT=y
BR2_LINUX_KERNEL_CUSTOM_REPO_URL="git://arago-project.org/git/projects/linux-omap3.git"
BR2_LINUX_KERNEL_CUSTOM_REPO_VERSION="master"
BR2_LINUX_KERNEL_PATCH="$(BR2_EXTERNAL_INSYS_DM8168_PATH)/insys/common/patches"
BR2_LINUX_KERNEL_DEFCONFIG="fm403c"
BR2_LINUX_KERNEL_UIMAGE=y
BR2_PACKAGE_BUSYBOX_CONFIG_FRAGMENT_FILES="$(BR2_EXTERNAL_INSYS_DM8168_PATH)/insys/common/busybox.config"
BR2_TARGET_ROOTFS_TAR_BZIP2=y
```

## board/configs/fmc130e_defconfig
```kconfig
BR2_arm=y
BR2_cortex_a9=y
BR2_ARM_ENABLE_NEON=y
BR2_ARM_ENABLE_VFP=y
BR2_DL_DIR="$(TOPDIR)/../downloads/fmc130e"
BR2_TOOLCHAIN_EXTERNAL=y
BR2_TOOLCHAIN_EXTERNAL_GDB_SERVER_COPY=y
BR2_LINUX_KERNEL=y
BR2_LINUX_KERNEL_CUSTOM_GIT=y
BR2_LINUX_KERNEL_CUSTOM_REPO_URL="https://github.com/Xilinx/linux-xlnx.git"
BR2_LINUX_KERNEL_CUSTOM_REPO_VERSION="xilinx-v2020.1"
BR2_LINUX_KERNEL_USE_CUSTOM_CONFIG=y
BR2_LINUX_KERNEL_CUSTOM_CONFIG_FILE="$(BR2_EXTERNAL)/insys/fmc130e/linux.config"
BR2_LINUX_KERNEL_DTS_SUPPORT=y
BR2_LINUX_KERNEL_CUSTOM_DTS_PATH="$(BR2_EXTERNAL)/insys/fmc130e/fmc130e_v11.dts"
BR2_PACKAGE_LINUX_TOOLS_GPIO=y
BR2_PACKAGE_LINUX_TOOLS_PCI=y
BR2_PACKAGE_LINUX_TOOLS_PERF=y
```

## board/package/bardy/Config.in
```kconfig
config BR2_PACKAGE_BARDY
	bool "bardy"
	depends on BR2_PACKAGE_GIPCY
	help
	  bardy is a software library framwork for InSys hardware.

	  https://insys.ru

comment "Provide for controlling of hardware."
```

## board/package/gipcy/Config.in
```kconfig
config BR2_PACKAGE_GIPCY
	bool "gipcy"
	help
	  gipcy is a tiny IPC library for controlling of shared
	  resource usage. It is need a kernel module ipcdrv, that
	  included in library source code.

	  https://github.com/karakozov/gipcy

comment "Provide for controlling of shared resources using."
```
